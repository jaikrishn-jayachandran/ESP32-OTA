## sdkconfig.defaults
```kconfig
# =============== FOR DEBUGGING ONLY ====================
CONFIG_LOG_DEFAULT_LEVEL_DEBUG=y
CONFIG_MQTT_LOG_LEVEL_DEBUG=y
# =======================================================

# Flash Configuration
CONFIG_ESPTOOLPY_FLASHSIZE_4MB=y
CONFIG_ESPTOOLPY_FLASHSIZE="4MB"

# Custom Partition Table
CONFIG_PARTITION_TABLE_CUSTOM=y
CONFIG_PARTITION_TABLE_CUSTOM_FILENAME="partitions.csv"
CONFIG_PARTITION_TABLE_FILENAME="partitions.csv"
CONFIG_PARTITION_TABLE_OFFSET=0x8000
CONFIG_PARTITION_TABLE_MD5=y

# Bootloader & OTA Anti-Rollback Support
CONFIG_BOOTLOADER_APP_ROLLBACK_ENABLE=y

# HTTPS OTA Security Settings
CONFIG_ESP_HTTPS_OTA_ALLOW_HTTP=n
CONFIG_ESP_TLS_USING_MBEDTLS=y
CONFIG_ESP_TLS_INSECURE=y
CONFIG_ESP_TLS_SKIP_SERVER_CERT_VERIFY=y

# Cryptography & TLS Support
CONFIG_MBEDTLS_SSL_PROTO_TLS1_2=y
CONFIG_MBEDTLS_AES_C=y
CONFIG_MBEDTLS_GCM_C=y
CONFIG_MBEDTLS_SHA256_C=y
CONFIG_MBEDTLS_BASE64_C=y
CONFIG_MBEDTLS_CERTIFICATE_BUNDLE=y
CONFIG_MBEDTLS_CERTIFICATE_BUNDLE_DEFAULT_FULL=y

# Watchdog Timers
CONFIG_ESP_TASK_WDT_EN=y
CONFIG_ESP_TASK_WDT_INIT=y
CONFIG_ESP_TASK_WDT_PANIC=y
CONFIG_ESP_TASK_WDT_TIMEOUT_S=15

# System & Memory Integrity
CONFIG_COMPILER_STACK_CHECK=y
CONFIG_COMPILER_STACK_CHECK_MODE_NORM=y
CONFIG_HEAP_POISONING_LIGHT=y
CONFIG_HEAP_ABORT_WHEN_ALLOCATION_FAILS=y

# Logging Level
CONFIG_LOG_DEFAULT_LEVEL_INFO=y
```
